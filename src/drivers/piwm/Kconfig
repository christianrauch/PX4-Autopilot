## src/drivers/piwm/Kconfig
```kconfig
menuconfig DRIVERS_PIWM
    bool "piwm"
    default n
	---help---
	    Enable support for piwm
```

## src/drivers/test_pwm_out/Kconfig
```kconfig
menuconfig DRIVERS_test_PWM_OUT
	bool "test_pwm_out"
	default n
	---help---
		Enable support for a test PWM output
```
